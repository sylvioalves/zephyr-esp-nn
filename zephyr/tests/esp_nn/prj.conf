## CMakeLists.txt
```
# Copyright (c) 2026 Espressif Systems (Shanghai) Co., Ltd.
# SPDX-License-Identifier: Apache-2.0

cmake_minimum_required(VERSION 3.28.0)
find_package(Zephyr REQUIRED HINTS $ENV{ZEPHYR_BASE})
project(esp_nn_kernels)

file(GLOB esp_nn_tests ${ZEPHYR_ESP_NN_MODULE_DIR}/tests/src/*.c)
set_source_files_properties(src/main.c ${esp_nn_tests} PROPERTIES
  COMPILE_OPTIONS "-Wno-unused-function;-Wno-pointer-arith"
)

target_sources(app PRIVATE src/main.c ${esp_nn_tests})
target_include_directories(app PRIVATE
  ${ZEPHYR_ESP_NN_MODULE_DIR}/tests/include
  ${ZEPHYR_ESP_NN_MODULE_DIR}/src/common
)
```

## prj.conf
```kconfig
CONFIG_ZTEST=y
CONFIG_ZTEST_STACK_SIZE=16384
CONFIG_ESP_NN=y
```

## src/main.c
```c
/*
 * Copyright (c) 2026 Espressif Systems (Shanghai) Co., Ltd.
 *
 * SPDX-License-Identifier: Apache-2.0
 */

#include <zephyr/ztest.h>
#include <esp_cpu.h>

#include <test_functions.h>
#include <test_utils.h>

static uint32_t start_c;
static uint32_t start_opt;

void profile_c_start(void)
{
	start_c = esp_cpu_get_cycle_count();
}

uint32_t profile_c_end(void)
{
	return esp_cpu_get_cycle_count() - start_c;
}

void profile_opt_start(void)
{
	start_opt = esp_cpu_get_cycle_count();
}

uint32_t profile_opt_end(void)
{
	return esp_cpu_get_cycle_count() - start_opt;
}

#define ESP_NN_TEST(name, fn)                                                                      \
	ZTEST(esp_nn, test_##name)                                                                 \
	{                                                                                          \
		uint32_t failed = esp_nn_test_failed;                                              \
                                                                                                   \
		fn();                                                                              \
		zassert_equal(esp_nn_test_failed, failed, "%u case(s) failed",                     \
			      esp_nn_test_failed - failed);                                        \
	}

ESP_NN_TEST(add_s8, esp_nn_add_elementwise_s8_test)
ESP_NN_TEST(mul_s8, esp_nn_mul_elementwise_s8_test)
ESP_NN_TEST(mul_broadcast_ch_s8, esp_nn_mul_broadcast_channel_s8_test)
ESP_NN_TEST(depthwise_conv_s8, esp_nn_depthwise_conv_s8_test)
ESP_NN_TEST(conv_s8, esp_nn_conv_s8_test)
ESP_NN_TEST(relu6_s8, esp_nn_relu6_s8_test)
ESP_NN_TEST(avg_pool_s8, esp_nn_avg_pool_s8_test)
ESP_NN_TEST(max_pool_s8, esp_nn_max_pool_s8_test)
ESP_NN_TEST(fc_s8, esp_nn_fully_connected_s8_test)
ESP_NN_TEST(fc_per_ch_s8, esp_nn_fully_connected_per_ch_s8_test)
ESP_NN_TEST(fc_per_ch_s8_batch, esp_nn_fully_connected_per_ch_s8_batch_test)
ESP_NN_TEST(fc_align_s8, esp_nn_fully_connected_align_s8_test)
ESP_NN_TEST(fc_perf, esp_nn_fully_connected_perf_test)
ESP_NN_TEST(softmax_s8, esp_nn_softmax_s8_test)
ESP_NN_TEST(hard_swish_s8, esp_nn_hard_swish_s8_test)
ESP_NN_TEST(mean_nhwc_s8, esp_nn_mean_nhwc_s8_test)

ZTEST_SUITE(esp_nn, NULL, NULL, NULL, NULL, NULL);
```
